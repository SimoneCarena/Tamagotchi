#include <stdio.h>
#include <stdlib.h>

#include "LPC17xx.h"
#include "../GLCD/GLCD.h" 
#include "img_handler.h"
#include "timer.h"
#include "../RIT/RIT.h"

#define SPRITE_1 0
#define SPRITE_2 1

uint32_t baccarancia_row_pos = 190;
uint32_t baccarancia_col_pos = 10;
uint32_t bidoof_1_col_pos = 90;
uint32_t bidoof_1_row_pos = 160;
uint32_t bidoof_2_col_pos = 95;
uint32_t bidoof_2_row_pos = 150;
uint32_t rare_candy_row_pos = 190;
uint32_t rare_candy_col_pos = 10;
uint32_t happiness_row_pos = 65;
uint32_t happiness_col_pos = 30;
uint32_t hunger_row_pos = 65;
uint32_t hunger_col_pos = 160;
uint32_t volume_row_pos = 5;
uint32_t volume_col_pos = 5;

const uint16_t hunger[HUNGER_ROWS][HUNGER_COLUMNS] = {
	{65535,65535,65535,65535,65535,65535,65535,0,0,0,0},
	{65535,65535,65535,65535,65535,65535,0,0,52760,52760,0},
	{65535,65535,65535,65535,65535,65535,0,52760,52760,0,0},
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	{65535,0,0,0,0,0,65535,65535,65535,65535,65535}
};

const uint16_t happiness[HAPPINESS_ROWS][HAPPINESS_COLUMNS] = {
	{65535,65534,0,64,0,61406,61341,2048,32,32,65533,65502},
	{65535,0,57408,57345,59393,0,32,55360,59392,57346,0,65534},
	{1,61440,63520,63520,63488,57344,57344,63488,63552,61506,57347,0},
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	{65535,65535,65535,65471,65535,32,32,65535,65535,65535,65535,65535}
};

const uint16_t baccarancia[BACCARANCIA_ROWS][BACCARANCIA_COLUMNS] = {
	{65535,65535,65535,65535,65535,65535,65535,65535,65535,65535,65535,65535,65535,65535,65535,50903,32044,25738,46677,65535,65535,65535,65535,65535,65535,65535,65535,65535,65535,65535,65535,65535,65535,65535},
	{65535,65535,65535,65535,65535,65535,65535,65535,65535,65535,65535,65535,65535,65535,52983,44689,40526,36301,38320,48759,65503,65535,65535,65535,65535,65535,65535,65535,65535,65535,65535,65535,65535,65535},
	{65535,65535,65535,65535,65535,65535,65535,65535,65535,65535,65535,65535,63421,52952,36271,36333,40558,36333,32076,36207,52952,63421,65535,65535,65535,65535,65535,65535,65535,65535,65535,65535,65535,65535},
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	{65535,65535,65535,65535,65535,65535,65535,65503,65503,65503,63390,33879,16914,16914,16914,16914,16914,16914,16914,16914,16914,16914,33879,63390,65503,65503,65503,65535,65535,65535,65535,65535,65535,65535}
};

const uint16_t bidoof_2[BIDOOF_2_ROWS][BIDOOF_2_COLUMNS] = {
	{65535,65535,65535,65535,65535,65535,65535,65535,65535,65535,65535,65535,65535,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65535,65535},
	{65535,65535,65535,65535,65535,65535,65535,65535,65535,65535,65535,65535,65535,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65535,65535},
	{65535,65535,65535,65535,65535,65535,65535,65535,65535,65535,65535,65535,65535,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65535,65535},
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	{65535,65535,65535,65535,65535,65535,65535,65535,65535,65535,65535,50712,19049,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65535,65535}
};

const uint16_t bidoof_1[BIDOOF_1_ROWS][BIDOOF_1_COLUMNS] = {
	{65535,65535,65535,65535,65535,65535,65535,65535,65535,65535,65535,65535,65535,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65535,65535},
	{65535,65535,65535,65535,65535,65535,65535,65535,65535,65535,65535,65535,65535,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65535,65535},
	{65535,65535,65535,65535,65535,65535,65535,65535,65535,65535,65535,65535,65535,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65535,65535},
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	{65535,65535,65535,65535,65535,65535,65535,65535,65535,65535,65535,65535,65535,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65535,65535}
};

const uint16_t rare_candy[RARE_CANDY_ROWS][RARE_CANDY_COLUMNS] = {
	{65535,65535,65535,65535,65535,65535,65535,65535,65535,65535,65535,65535,65535,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65535,65535},
	{65535,65535,65535,65535,65535,65535,65535,65535,65535,65535,65535,65535,65535,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65535,65535},
	{65535,65535,65535,65535,65535,65535,65535,65535,65535,65535,65535,65535,65535,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65535,65535},
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	{65535,65535,65535,65535,65535,65535,65535,65535,65535,65535,65535,65535,44405,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65535,65535}
};

const uint16_t volume[VOLUME_ROWS][VOLUME_COLUMNS] = {
	{65535,65535,65535,65535,65535,65535,65535,65535,65535,65535,65535,65535,65535,65535,65535,65535,65535,50744,27501,31695},
	{65535,65535,65535,65535,65535,65535,65535,65535,65535,65535,65535,65535,65535,65535,65535,65503,42292,10597,32,8452},
	{65535,65535,65535,65535,65535,65535,65535,65535,65535,65535,65535,65535,65535,65535,61309,38066,4226,0,0,8452},
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	{65535,65535,65535,65535,65535,65535,65535,65535,65535,65535,65535,65535,65535,65535,65535,63422,42292,12710,0,8452}
};
static void draw_bidoof_1(uint32_t start_row, uint32_t start_col){

	int row, column;
	int i,j;
	
	row = start_row;
	for(i=0;i<BIDOOF_1_ROWS;i++){
		column = start_col;
		for(j=0;j<BIDOOF_1_COLUMNS;j++){
			LCD_SetPoint(column,row,bidoof_1[i][j]);
			column++;
		}
		row++;
	}

}

static void draw_bidoof_2(uint32_t start_row, uint32_t start_col){

	int row, column;
	int i,j;
	
	row = start_row;
	for(i=0;i<BIDOOF_2_ROWS;i++){
		column = start_col;
		for(j=0;j<BIDOOF_2_COLUMNS;j++){
			LCD_SetPoint(column,row,bidoof_2[i][j]);
			column++;
		}
		row++;
	}

}

static void draw_baccarancia(uint32_t start_row, uint32_t start_col){

	int row, column;
	int i,j;
	
	row = start_row;
	for(i=0;i<BACCARANCIA_ROWS;i++){
		column = start_col;
		for(j=0;j<BACCARANCIA_COLUMNS;j++){
			LCD_SetPoint(column,row,baccarancia[i][j]);
			column++;
		}
		row++;
	}

}

static void draw_rare_candy(uint32_t start_row, uint32_t start_col){

	int row, column;
	int i,j;
	
	row = start_row;
	for(i=0;i<RARE_CANDY_ROWS;i++){
		column = start_col;
		for(j=0;j<RARE_CANDY_COLUMNS;j++){
			LCD_SetPoint(column,row,rare_candy[i][j]);
			column++;
		}
		row++;
	}

}

static void draw_hunger(uint32_t start_row, uint32_t start_col){

	int row, column;
	int i,j;
	
	row = start_row;
	for(i=0;i<HUNGER_ROWS;i++){
		column = start_col;
		for(j=0;j<HUNGER_COLUMNS;j++){
			LCD_SetPoint(column,row,hunger[i][j]);
			column++;
		}
		row++;
	}

}

static void draw_happiness(uint32_t start_row, uint32_t start_col){

	int row, column;
	int i,j;
	
	row = start_row;
	for(i=0;i<HAPPINESS_ROWS;i++){
		column = start_col;
		for(j=0;j<HAPPINESS_COLUMNS;j++){
			LCD_SetPoint(column,row,happiness[i][j]);
			column++;
		}
		row++;
	}

}

static void draw_volume(uint32_t start_row, uint32_t start_col){

	int row, column;
	int i,j;
	
	row = start_row;
	for(i=0;i<VOLUME_ROWS;i++){
		column = start_col;
		for(j=0;j<VOLUME_COLUMNS;j++){
			LCD_SetPoint(column,row,volume[i][j]);
			column++;
		}
		row++;
	}


}

static void clear_shape(uint32_t start_row, uint32_t start_col, uint32_t rows, uint32_t columns, uint16_t color){

	int row, column;
	int i,j;
	
	row = start_row;
	for(i=0;i<rows;i++){
		column = start_col;
		for(j=0;j<columns;j++){
			LCD_SetPoint(column,row,color);
			column++;
		}
		row++;
	}

}

char age[] = "Age: 00:00:00";
uint32_t hours = 0;
uint32_t minutes = 0;
uint32_t seconds = 0;
uint8_t happiness_val = 5;
uint8_t hunger_val = 5;
uint8_t sprite = SPRITE_1;
volatile uint8_t dead;
extern uint8_t active_swap;
extern uint8_t active_cuddle;
extern uint8_t current_volume_value;

void tamagotchi_setup(void){

	char *snack_text = "SNACK";
	char *food_text = "FOOD";
	char *happiness_txt = "HAPPINESS";
	char *hunger_txt = "SATIETY";
	int k;
	
	dead = ALIVE;
	hours = 0;
	minutes = 0;
	seconds = 0;
	hunger_val = 5;
	happiness_val = 5;
	sprite = SPRITE_1;
	active_swap = 1;
	active_cuddle = 0;
	current_volume_value = VOLUME_OFF;
	
	sprintf(age,"Age: %02d:%02d:%02d",hours,minutes,seconds);
	LCD_Clear(White);
	outline_selection_food(Black);
	outline_selection_snack(Black);
	GUI_Text(40,280,(uint8_t *)snack_text,Black,White);
	GUI_Text(155,280,(uint8_t *)food_text,Black,White);
	GUI_Text(60,10,(uint8_t *)age,Black,White);
	
	draw_bidoof_1(bidoof_1_row_pos,bidoof_1_col_pos);
	
	GUI_Text(28,45,(uint8_t *) happiness_txt, Black, White);
	GUI_Text(165,45,(uint8_t *) hunger_txt, Black, White);
	
	draw_volume(volume_row_pos, volume_col_pos);
	add_volume();
	current_volume_value++;
	add_volume();
	current_volume_value++;
	add_volume();
	current_volume_value++;
	
	for(k=0;k<5;k++){
		draw_happiness(happiness_row_pos,happiness_col_pos + k*(HAPPINESS_COLUMNS + 1));
		draw_hunger(hunger_row_pos,hunger_col_pos + k*(HUNGER_COLUMNS + 1));
	}
	
	init_timer(0,SEC_1); //age_timer && swap_sprite
	init_timer(1,SEC_5); //decrease stats timer
	init_RIT(POLL_TIM);	//polling_timer	
	reset_RIT();
	reset_timer(0);
	reset_timer(1);
	enable_timer(0);
	enable_timer(1);
	enable_RIT();
	
}

void update_age(void){

	if(seconds == 59){
		seconds = 0;
		if(minutes == 59){
			minutes = 0;
			if(hours == 23){
				hours = 0;
			}
			else{
				hours++;
			}
		}
		else{
			minutes++;
		}
	}
	else{
		seconds++;
	}
	
	sprintf(age,"Age: %02d:%02d:%02d",hours,minutes,seconds);
	GUI_Text(60,10,(uint8_t *)age,Black,White);

}

int remove_happiness(void){
	
	happiness_val--;
	clear_shape(happiness_row_pos,happiness_col_pos + happiness_val*(HAPPINESS_COLUMNS + 1),HAPPINESS_ROWS,HAPPINESS_COLUMNS,White);
	
	return happiness_val;
	
}

int remove_hunger(void){
	
	hunger_val--;
	clear_shape(hunger_row_pos,hunger_col_pos + hunger_val*(HUNGER_COLUMNS + 1),HUNGER_ROWS,HUNGER_COLUMNS,White);
	
	return hunger_val;
	
}

void add_happiness(void){
	
	if(happiness_val>=5){
		return;
	}
	
	draw_happiness(happiness_row_pos,happiness_col_pos + happiness_val*(HAPPINESS_COLUMNS + 1));
	
	happiness_val++;
	
}

void add_hunger(void){
	
	if(hunger_val>=5){
		return;
	}
	
	draw_hunger(hunger_row_pos,hunger_col_pos + hunger_val*(HUNGER_COLUMNS + 1));
	
	hunger_val++;
	
}

void swap_sprite(void){
	
	switch(sprite){
		case SPRITE_1:
			clear_shape(bidoof_1_row_pos,bidoof_1_col_pos,BIDOOF_1_ROWS,BIDOOF_1_COLUMNS,White);
			draw_bidoof_2(bidoof_2_row_pos,bidoof_2_col_pos);
			sprite = SPRITE_2;
			break;
		case SPRITE_2:
			clear_shape(bidoof_2_row_pos,bidoof_2_col_pos,BIDOOF_2_ROWS,BIDOOF_2_COLUMNS,White);
			draw_bidoof_1(bidoof_1_row_pos,bidoof_1_col_pos);
			sprite = SPRITE_1;
			break;
		default:
			break;
	}
	
}

void eat_food(void){
	
	int x,y;
	
	draw_baccarancia(baccarancia_row_pos,baccarancia_col_pos);
	
	switch(sprite){
		case SPRITE_1:
			x = bidoof_1_col_pos;
			y = bidoof_1_row_pos;
			while(x > baccarancia_col_pos){
				clear_shape(y,x,BIDOOF_1_ROWS,BIDOOF_1_COLUMNS,White);
				if((x-5)<=baccarancia_col_pos+BACCARANCIA_COLUMNS){
					x-=(5+BACCARANCIA_COLUMNS);
				}
				else{
					x-=5;
				}
				draw_bidoof_1(y,x);
			}
			clear_shape(y,x,BIDOOF_1_ROWS,BIDOOF_1_COLUMNS,White);
			draw_bidoof_1(bidoof_1_row_pos,bidoof_1_col_pos);
			break;
		case SPRITE_2:
			x = bidoof_2_col_pos;
			y = bidoof_2_row_pos;
			while(x > baccarancia_col_pos){
				clear_shape(y,x,BIDOOF_2_ROWS,BIDOOF_2_COLUMNS,White);
				if((x-5)<=baccarancia_col_pos+BACCARANCIA_COLUMNS){
					x-=(5+BACCARANCIA_COLUMNS);
				}
				else{
					x-=5;
				}
				draw_bidoof_2(y,x);
			}
			clear_shape(y,x,BIDOOF_2_ROWS,BIDOOF_2_COLUMNS,White);
			draw_bidoof_2(bidoof_2_row_pos,bidoof_2_col_pos);
			break;
		default:
			break;
	}
	
	add_hunger();
	
}

void eat_snack(void){
	
	int x,y;
	
	draw_rare_candy(rare_candy_row_pos,rare_candy_col_pos);
	
	switch(sprite){
		case SPRITE_1:
			x = bidoof_1_col_pos;
			y = bidoof_1_row_pos;
			while(x > rare_candy_col_pos){
				clear_shape(y,x,BIDOOF_1_ROWS,BIDOOF_1_COLUMNS,White);
				if((x-5)<=rare_candy_col_pos+RARE_CANDY_COLUMNS){
					x-=(5+RARE_CANDY_COLUMNS);
				}
				else{
					x-=5;
				}
				draw_bidoof_1(y,x);
			}
			clear_shape(y,x,BIDOOF_1_ROWS,BIDOOF_1_COLUMNS,White);
			draw_bidoof_1(bidoof_1_row_pos,bidoof_1_col_pos);
			break;
		case SPRITE_2:
			x = bidoof_2_col_pos;
			y = bidoof_2_row_pos;
			while(x > rare_candy_col_pos){
				clear_shape(y,x,BIDOOF_2_ROWS,BIDOOF_2_COLUMNS,White);
				if((x-5)<=rare_candy_col_pos+RARE_CANDY_COLUMNS){
					x-=(5+RARE_CANDY_COLUMNS);
				}
				else{
					x-=5;
				}
				draw_bidoof_2(y,x);
			}
			clear_shape(y,x,BIDOOF_2_ROWS,BIDOOF_2_COLUMNS,White);
			draw_bidoof_2(bidoof_2_row_pos,bidoof_2_col_pos);
			break;
		default:
			break;
	}
	
	add_happiness();
	
}

void death_animation(void){

	int x = 75;
	int y = 80;
	char text1[] = "Your lack of care and";
	char text2[] = "attentions made Bidoof";
	char text3[] = "leave you.";
	char game_over[] = "GAME OVER";
	char reset_text1[] = "Press the joystick";
	char reset_text2[] = "to restart";
	
	clear_shape(45,0,290,240,White);
	
	draw_bidoof_1(y,x);
	while(y<=320){
		clear_shape(y,x,BIDOOF_1_ROWS,BIDOOF_1_COLUMNS,White);
		y+=10;
		draw_bidoof_1(y,x);
	}
	
	LCD_DrawLine(20,200,220,200,Black);
	LCD_DrawLine(20,255,220,255,Black);
	LCD_DrawLine(20,200,20,255,Black);
	LCD_DrawLine(220,200,220,255,Black);
	draw_reset_button(Red);
	GUI_Text(30,205,(uint8_t *)text1,Black,White);
	GUI_Text(30,220,(uint8_t *)text2,Black,White);
	GUI_Text(30,235,(uint8_t *)text3,Black,White);
	GUI_Text(85,90,(uint8_t *)game_over,Black,White);
	GUI_Text(55,115,(uint8_t *)reset_text1,Black,White);
	GUI_Text(75,130,(uint8_t *)reset_text2,Black,White);

}

void outline_selection_snack(uint16_t color){
	
	LCD_DrawLine(1,260,120,260,color);
	LCD_DrawLine(1,319,120,319,color);
	LCD_DrawLine(1,260,1,319,color);
	LCD_DrawLine(120,260,120,319,color);
	
}

void outline_selection_food(uint16_t color){

	LCD_DrawLine(120,260,239,260,color);
	LCD_DrawLine(120,319,239,319,color);
	LCD_DrawLine(120,260,120,319,color);
	LCD_DrawLine(239,260,239,319,color);

}

void draw_reset_button(uint16_t color){
	
	char text[] = "RESET";

	LCD_DrawLine(1,260,239,260,color);
	LCD_DrawLine(1,319,239,319,color);
	LCD_DrawLine(1,260,1,319,color);
	LCD_DrawLine(239,260,239,319,color);
	GUI_Text(100,280,(uint8_t *)text,Black,White);	

}

uint8_t check_point(uint8_t x, uint8_t y){

	switch(sprite){
		case SPRITE_1:
			if((x>=bidoof_1_col_pos) && (x<=bidoof_1_col_pos+BIDOOF_1_COLUMNS) && (y>=bidoof_1_row_pos) && (y<=bidoof_1_row_pos+BIDOOF_1_ROWS)){
				return 1;
			}
			return 0;
		case SPRITE_2:
			if((x>=bidoof_2_col_pos) && (x<=bidoof_2_col_pos+BIDOOF_2_COLUMNS) && (y>=bidoof_2_row_pos) && (y<=bidoof_2_row_pos+BIDOOF_2_ROWS)){
				return 1;
			}
			return 0;
	}
	
	return 0;
	
}

const uint8_t points1_x[] = {20,30,40,50,60,70,80,90,170,110};
const uint8_t points1_y[] = {140,160,110,180,130,130,110,130,150,140};
const uint8_t points2_x[] = {30,40,50,60,70,80,90,100,170,120};
const uint8_t points2_y[] = {130,150,170,140,160,120,90,130,150,100};
const uint8_t times=5;
const uint8_t hearts=10;

void cuddle_animation_1(void){

		uint8_t i;
		for(i=0;i<hearts;i++){
			draw_happiness(points1_y[i],points1_x[i]);
		}
	
}

void cuddle_animation_2(void){

		uint8_t i;
		for(i=0;i<hearts;i++){
			clear_shape(points1_y[i],points1_x[i],HAPPINESS_ROWS,HAPPINESS_COLUMNS,White);
		}
		for(i=0;i<hearts;i++){
			draw_happiness(points2_y[i],points2_x[i]);
		}
	
}

void cuddle_animation_3(void){

	uint8_t i;
		for(i=0;i<hearts;i++){
			clear_shape(points2_y[i],points2_x[i],HAPPINESS_ROWS,HAPPINESS_COLUMNS,White);
		}

}

uint8_t bar3_row_pos = 7;
uint8_t bar3_col_pos = 36;
uint8_t bar2_row_pos = 9;
uint8_t bar2_col_pos = 33;
uint8_t bar1_row_pos = 11;
uint8_t bar1_col_pos = 30;

void add_volume(void){
	
	uint8_t i,j;
	uint32_t row,column;

	switch(current_volume_value){
		case VOLUME_MAX:
			return;
		case VOLUME_OFF:
			row = bar1_row_pos;
			for(i=0;i<16;i++){
				column = bar1_col_pos;
				for(j=0;j<2;j++){
					LCD_SetPoint(column,row,Black);
					column++;
				}
				row++;
			}
			break;
		case VOLUME_1:
			row = bar2_row_pos;
			for(i=0;i<20;i++){
				column = bar2_col_pos;
				for(j=0;j<2;j++){
					LCD_SetPoint(column,row,Black);
					column++;
				}
				row++;
			}
			break;
		case VOLUME_2:
			row = bar3_row_pos;
			for(i=0;i<24;i++){
				column = bar3_col_pos;
				for(j=0;j<2;j++){
					LCD_SetPoint(column,row,Black);
					column++;
				}
				row++;
			}
	}

}

void remove_volume(void){

	uint8_t i,j;
	uint32_t row,column;

	switch(current_volume_value){
		case VOLUME_OFF:
			return;
		case VOLUME_1:
			row = bar1_row_pos;
			for(i=0;i<16;i++){
				column = bar1_col_pos;
				for(j=0;j<2;j++){
					LCD_SetPoint(column,row,White);
					column++;
				}
				row++;
			}
			break;
		case VOLUME_2:
			row = bar2_row_pos;
			for(i=0;i<20;i++){
				column = bar2_col_pos;
				for(j=0;j<2;j++){
					LCD_SetPoint(column,row,White);
					column++;
				}
				row++;
			}
			break;
		case VOLUME_MAX:
			row = bar3_row_pos;
			for(i=0;i<24;i++){
				column = bar3_col_pos;
				for(j=0;j<2;j++){
					LCD_SetPoint(column,row,White);
					column++;
				}
				row++;
			}
	}
	
}
